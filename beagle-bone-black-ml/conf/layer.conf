## terasic-ml/conf/machine/terasic-ml.conf
```bitbake
#####################################################################
#
#@TYPE: Machine
#@NAME: terasic-ml
#
#@DESCRIPTION: Machine configuration for terasic-ml systems
#
#####################################################################

PREFERRED_PROVIDER_virtual/xserver ?= "xserver-xorg"
XSERVER ?= "xserver-xorg \
           xf86-input-evdev \
           xf86-input-mouse \
           xf86-video-omapfb \
           xf86-input-keyboard"

#####################################################################
#
# Machine definition section
#
#####################################################################

# Altera Cyclone V HPS part contains dual ARM Cortex-A9 cores.
# Require a proper tune options for ARM for Terasic target.
#
# NOTE: Should you have any issues with "broken" components due
# to the usage of the VFP, the you should uncomment below line:
#DEFAULTTUNE ?= "cortexa9-neon"
# and comment below line. Otherwise, VFP-supported builds are
# performed.

DEFAULTTUNE ?= "cortexa9hf-neon"
require conf/machine/include/tune-cortexa9.inc

# Additional machine features included in the image:
MACHINE_FEATURES = "apm usbgadget usbhost vfat alsa lighttpd"

#####################################################################

#####################################################################
#
# Bootloader section
#
#####################################################################

# Our machine is based on Altera-specific bootloader, we declare it here
EXTRA_IMAGEDEPENDS += "u-boot-altera"

# U-Boot version
PREFERRED_PROVIDER_virtual/bootloader = "u-boot-altera"
PREFERRED_VERSION_u-boot-altera ?= "v2014.10%"

# Configuration the U-Boot is built against
UBOOT_MACHINE = "socfpga_cyclone5_defconfig"

# In case if the mainline U-Boot is needed, above block should be
# commented out and following line should be un-commented:
#EXTRA_IMAGEDEPENDS += "u-boot"
#PREFERRED_PROVIDER_virtual/bootloader = "u-boot"
#PREFERRED_VERSION_u-boot ?= "v2015.07%"
#UBOOT_MACHINE = "socfpga_cyclone5_defconfig"

# Additional Bootloader parameters
UBOOT_ENTRYPOINT = "0x80008000"
UBOOT_LOADADDRESS = "0x80008000"

# Allow for MMC booting (required by the NAND-less Beagleboard XM)
# @@@ hack to get it to compile
#EXTRA_IMAGEDEPENDS += "u-boot x-load"
#####################################################################

#####################################################################
#
# Linux Kernel section
#
#####################################################################

# Kernel version
PREFERRED_PROVIDER_virtual/kernel ?= "linux-yocto-custom"
PREFERRED_VERSION_linux-yocto-custom = "4.1.0%"

# File system types
IMAGE_FSTYPES += "tar.bz2"
EXTRA_IMAGECMD_jffs2 = "-lnp "

# 2.6.37 and later kernels use OMAP_SERIAL, ttyO0
# earlier kernels use ttyS0
SERIAL_CONSOLE = "115200 ttyS0"

# Kernel image type to be generated:
#KERNEL_IMAGETYPE = "uImage"
KERNEL_IMAGEYPE = "zImage"

# Ship all kernel modules by default
MACHINE_EXTRA_RRECOMMENDS = " kernel-modules"

KERNEL_EXTRA_ARGS += "LOADADDR=${UBOOT_ENTRYPOINT}"
KERNEL_DEVICETREE += "${S}/arch/arm/boot/dts/socfpga_cyclone5_sockit.dts"
#####################################################################

#####################################################################
#
# Additional package definitions section
#
#####################################################################

# perf does not build on a 3.13.x kernel, so we exclude it for now
# BBMASK = "/meta/recipes-kernel/perf"
# we'll patch it to compile:
# https://github.com/openembedded/oe-core/tree/master/meta/recipes-kernel/perf

# lttng-modules breaks on a 3.14.x kernel, so we exclude it for now
# BBMASK .= "|meta/recipes-kernel/lttng"
# it seems to be easier to patch lttng
# https://github.com/openembedded/oe-core/tree/master/meta/recipes-kernel/lttng
# but lttng-modules 2.4.0 blacklists arm with gcc-4.8
# so we use lttng-modules 2.3.3 with the bio-bvec-iter.patch and
# also the good old versions of lttng-tools and lttng-ust
# bitbake -s | grep lttng
# lttng-modules                                       :2.3.3-r0
# lttng-tools                                        :v2.3.1-r0
# lttng-ust                                          2:2.3.1-r0
# this is achieved by masking arm for all 3 recipes v2.4.0

#EXTRA_IMAGEDEPENDS += "lighttpd"

#####################################################################
```

## u-boot-wic-bsp/conf/layer.conf
```bitbake
# We have a conf and classes directory, add to BBPATH
BBPATH .= ":${LAYERDIR}"

# We have a recipes-* directories, add to BBFILES
BBFILES += "${LAYERDIR}/recipes-*/*/*.bb \
	${LAYERDIR}/recipes-*/*/*.bbappend"

BBFILE_COLLECTIONS += "u-boot-wic"
BBFILE_PATTERN_u-boot-wic = "^${LAYERDIR}/"
BBFILE_PRIORITY_u-boot-wic = "6"
```
