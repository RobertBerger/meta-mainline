## multi-v7-ml/conf/machine/multi-v7-ml.conf
```bitbake
#@TYPE: Machine
#@NAME: multi-v7-ml

#@DESCRIPTION: Machine configuration for multi-v7-ml systems

PREFERRED_PROVIDER_virtual/xserver ?= "xserver-xorg"
XSERVER ?= "xserver-xorg \
           xf86-input-evdev \
           xf86-input-mouse \
           xf86-video-omapfb \
           xf86-input-keyboard"

# --> opencv stuff
#PREFERRED_VERSION_opencv = "3.0%"
# <-- opencv stuff

# --> kernel stuff 

# kernel version
KERNEL_VERSION_PATCHLEVEL="4.9"
KERNEL_SUBLEVEL="44"
LINUXLIBCVERSION ?= "${KERNEL_VERSION_PATCHLEVEL}"

# --> standard/debug
ML_DEFAULT_KERNEL := "linux-yocto-custom"
PREFERRED_VERSION_linux-yocto-custom = "${KERNEL_VERSION_PATCHLEVEL}.${KERNEL_SUBLEVEL}%"
#KTYPE ?= "standard"
KTYPE ?= "debug"
# <-- standard/debug

# --> prt
#PRT_KERNEL_VERSION_PATCHLEVEL="3.18"
#PRT_KERNEL_SUBLEVEL="20"
#ML_DEFAULT_KERNEL := "linux-yocto-custom"
#PREFERRED_VERSION_linux-yocto-custom = "${PRT_KERNEL_VERSION_PATCHLEVEL}.${PRT_KERNEL_SUBLEVEL}%"
#KTYPE ?= "preempt-rt"
# <-- prt

# Ship all kernel modules by default
MACHINE_EXTRA_RRECOMMENDS = " kernel-modules"

# kernel provider
PREFERRED_PROVIDER_virtual/kernel ??= "${ML_DEFAULT_KERNEL}"

KERNEL_IMAGETYPE = "uImage"
# vmlinux needed for crosstap
KERNEL_ALT_IMAGETYPE = "vmlinux"

KMACHINE ?= "multi-v7-ml"

# we use a mainline defconfig and apply config fragments
# choose KTYPE for different sets of config fragments
#KTYPE ?= "standard"
#KTYPE ?= "debug"
# I don't know why, but not-smp-deb is broken
# I don't manage to set BROKEN_ON_SMP=y and friends
# KTYPE ?= "not-smp-deb"
# If you do not specify a LINUX_KERNEL_TYPE,
# it defaults to "standard"
LINUX_KERNEL_TYPE ?= "${KTYPE}"
# <-- kernel stuff

# --> u-boot stuff
# we build u-boot elsewhere
# u-boot not needed for rootfs, but build it anyhow
#EXTRA_IMAGEDEPENDS += "u-boot"

# u-boot version
#PREFERRED_VERSION_u-boot ?= "v2015.10%"

# for now just one board supported
#UBOOT_MACHINE = "am335x_boneblack_config"
# <-- u-boot stuff

# --> compiler tuning stuff 
# try this for generic armv7a image
DEFAULTTUNE = "armv7a-neon"
include conf/machine/include/arm/arch-armv7a.inc
# or require?
# <-- compiler tuning stuff

# --> rootfs stuff 
IMAGE_FSTYPES += "tar.bz2"
EXTRA_IMAGECMD_jffs2 = "-lnp "
# <-- rootfs stuff

# 2.6.37 and later kernels use OMAP_SERIAL, ttyO0
# earlier kernels use ttyS0
#SERIAL_CONSOLE = "115200 ttyO0"
SERIAL_CONSOLES="console;115200"

# in case we don't want LOAD_ADDR hardcoded:
# - need CONFIG_AUTO_ZRELADDR=y
# - need to compile kernel with UIMAGE_TYPE=kernel_noload
# - need in u-boot to load it at 0x80000000 + 0x8000 - 0x40 (U-boot header)
# - here it happens to work also with KERNEL_ADDR_R="0x80300000"

# replaced :
# -->
# hardcoded LOADADDR
#UBOOT_ENTRYPOINT = "0x80008000"
#UBOOT_LOADADDRESS = "0x80008000"
#KERNEL_EXTRA_ARGS += "LOADADDR=${UBOOT_ENTRYPOINT}"
# <--

# with:
# -->
# not hardcoded LOADADDR
UBOOT_ENTRYPOINT = "0x0"
UBOOT_LOADADDRESS = "0x0"
KERNEL_EXTRA_ARGS += "LOADADDR=${UBOOT_ENTRYPOINT} UIMAGE_TYPE=kernel_noload"
# <--

# board which should work with this kernel
KERNEL_DEVICETREE += "am335x-boneblack.dtb"
KERNEL_DEVICETREE += "am335x-bone.dtb"
KERNEL_DEVICETREE += "omap3-beagle-xm.dtb"
KERNEL_DEVICETREE += "omap3-beagle-xm-ab.dtb"
KERNEL_DEVICETREE += "omap3-beagle.dtb"
KERNEL_DEVICETREE += "omap3-igep0020.dtb"
KERNEL_DEVICETREE += "omap4-panda.dtb"
KERNEL_DEVICETREE += "omap4-panda-a4.dtb"
KERNEL_DEVICETREE += "omap4-panda-es.dtb"
KERNEL_DEVICETREE += "imx6dl-wandboard.dtb"
KERNEL_DEVICETREE += "imx6dl-wandboard-revb1.dtb"
KERNEL_DEVICETREE += "imx6q-wandboard.dtb"
KERNEL_DEVICETREE += "imx6q-wandboard-revb1.dtb"
KERNEL_DEVICETREE += "sun7i-a20-olinuxino-micro.dtb"
KERNEL_DEVICETREE += "zedboard-zynq7.dtb"
KERNEL_DEVICETREE += "zedboard-zynq7-res1.dtb"
# 3.18.20 does not have this:
# KERNEL_DEVICETREE += "omap3-igep0020-rev-f.dtb"
KERNEL_DEVICETREE += "sun7i-a20-bananapi.dtb"
KERNEL_DEVICETREE += "am335x-wega-rdk.dtb"
KERNEL_DEVICETREE += "imx6q-phytec-mira-rdk-nand.dtb"

MACHINE_FEATURES = "apm usbgadget usbhost vfat alsa"
```

## panda-ml/conf/layer.conf
```bitbake
# We have a conf and classes directory, add to BBPATH
BBPATH .= ":${LAYERDIR}"

# We have a recipes-* directories, add to BBFILES
BBFILES += "${LAYERDIR}/recipes-*/*/*.bb \
	${LAYERDIR}/recipes-*/*/*.bbappend"

BBFILE_COLLECTIONS += "panda-ml"
BBFILE_PATTERN_panda-ml = "^${LAYERDIR}/"
BBFILE_PRIORITY_panda-ml = "6"
```

## panda-ml/conf/machine/panda-ml.conf
```bitbake
#@TYPE: Machine
#@NAME: panda-ml

#@DESCRIPTION: Machine configuration for panda-ml systems

PREFERRED_PROVIDER_virtual/xserver ?= "xserver-xorg"
XSERVER ?= "xserver-xorg \
           xf86-input-evdev \
           xf86-input-mouse \
           xf86-video-omapfb \
           xf86-input-keyboard"


# Ship all kernel modules by default
MACHINE_EXTRA_RRECOMMENDS = " kernel-modules"

# Allow for MMC booting (required by the NAND-less Beagleboard XM)
# @@@ hack to get it to compile
#EXTRA_IMAGEDEPENDS += "u-boot x-load"
EXTRA_IMAGEDEPENDS += "u-boot"

PREFERRED_VERSION_u-boot ?= "v2013.10%"

# Uncomment the following line to enable the hard floating point abi. Note that
# this breaks some binary libraries and 3D (neither of which ship with
# meta-yocto). For maximum compatibility, leave this disabled.
#DEFAULTTUNE ?= "cortexa9hf-neon"
include conf/machine/include/tune-cortexa9.inc

IMAGE_FSTYPES += "tar.bz2 jffs2"
EXTRA_IMAGECMD_jffs2 = "-lnp "

# 2.6.37 and later kernels use OMAP_SERIAL, ttyO2
# earlier kernels use ttyS2
SERIAL_CONSOLE = "115200 ttyO2"

PREFERRED_PROVIDER_virtual/kernel ?= "linux-yocto-custom"

KERNEL_IMAGETYPE = "uImage"

UBOOT_MACHINE = "omap4_panda_config"
UBOOT_ENTRYPOINT = "0x80008000"
UBOOT_LOADADDRESS = "0x80008000"

KERNEL_EXTRA_ARGS += "LOADADDR=${UBOOT_ENTRYPOINT}"
KERNEL_DEVICETREE = "${S}/arch/arm/boot/dts/omap4-panda.dts "
KERNEL_DEVICETREE += "${S}/arch/arm/boot/dts/omap4-panda-a4.dts "
KERNEL_DEVICETREE += "${S}/arch/arm/boot/dts/omap4-panda-es.dts"

MACHINE_FEATURES = "apm usbgadget usbhost vfat alsa"
```

## phyboard-mira-imx6q-multi-v7-ml/conf/layer.conf
```bitbake
# We have a conf and classes directory, add to BBPATH
BBPATH .= ":${LAYERDIR}"

# We have a recipes-* directories, add to BBFILES
BBFILES += "${LAYERDIR}/recipes-*/*/*.bb \
	${LAYERDIR}/recipes-*/*/*.bbappend"

BBFILE_COLLECTIONS += "phyboard-mira-imx6q-multi-v7-ml"
BBFILE_PATTERN_phyboard-mira-imx6q-multi-v7-ml = "^${LAYERDIR}/"
BBFILE_PRIORITY_phyboard-mira-imx6q-multi-v7-ml = "7"
```

## phyboard-mira-imx6q-multi-v7-ml/conf/machine/phyboard-mira-imx6q-multi-v7-ml.conf
```bitbake
#@TYPE: Machine
#@NAME: phyboard-mira-imx6q-multi-v7-ml

#@DESCRIPTION: Machine configuration for phyboard-mira-imx6q-multi-v7-ml systems
#@ at the moment we build here only u-boot, the rest is built in multi-v7-ml

# --> u-boot stuff

# u-boot not needed for rootfs, but build it anyhow
EXTRA_IMAGEDEPENDS += "u-boot"

# u-boot version
PREFERRED_VERSION_u-boot ?= "v2016.09%"

# for now just one board supported
UBOOT_MACHINE = "pcm058_defconfig"
# <-- u-boot stuff

# --> compiler tuning stuff 
# try this for generic armv7a image
DEFAULTTUNE = "armv7a-neon"
include conf/machine/include/arm/arch-armv7a.inc
# <-- compiler tuning stuff
```

## phyboard-wega-am335x-1-ml/conf/layer.conf
```bitbake
# We have a conf and classes directory, add to BBPATH
BBPATH .= ":${LAYERDIR}"

# We have a recipes-* directories, add to BBFILES
BBFILES += "${LAYERDIR}/recipes-*/*/*.bb \
	${LAYERDIR}/recipes-*/*/*.bbappend"

BBFILE_COLLECTIONS += "phyboard-wega-am335x-1-ml"
BBFILE_PATTERN_phyboard-wega-am335x-1-ml = "^${LAYERDIR}/"
BBFILE_PRIORITY_phyboard-wega-am335x-1-ml = "6"
```

## socrates-ml/conf/layer.conf
```bitbake
# We have a conf and classes directory, add to BBPATH
BBPATH .= ":${LAYERDIR}"

# We have a recipes-* directories, add to BBFILES
BBFILES += "${LAYERDIR}/recipes-*/*/*.bb \
        ${LAYERDIR}/recipes-*/*/*.bbappend"

BBFILE_COLLECTIONS += "socrates-ml"
BBFILE_PATTERN_socrates-ml = "^${LAYERDIR}/"
# layer with higher number takes precedence
# try: bitbake-layers show-layers
BBFILE_PRIORITY_socrates-ml = "7"
# yves
BBDEBUG = "yes"
```

## socrates-ml/conf/machine/socfpga-cyclone5.conf
```bitbake
# copied from meta-altera
#@TYPE: Machine
#@NAME: SOCFPGA 
#@DESCRIPTION: Machine configuration for the Cyclone V SoC" 

# --> from meta-altera
require conf/machine/include/socfpga.inc

UBOOT_MACHINE = "socfpga_cyclone5"
# <-- from meta-altera

# --> added
# I want to build also kernel and u-boot automatically:
# this is the ltsi kernel e.g. 3.10:
#PREFERRED_PROVIDER_virtual/kernel = "linux-altera-ltsi"
# this is the altera kernel:
PREFERRED_PROVIDER_virtual/kernel = "linux-altera"
# specific version of altera kernel:
PREFERRED_VERSION_linux-altera = "3.14"
PREFERRED_PROVIDER_virtual/bootloader = "u-boot-socfpga"
#NOTE: multiple providers are available for u-boot-mkimage-native (u-boot-mkimage-native, u-boot-mkimage-socfpga-native, u-boot-mkimage-socfpga-local-native, u-boot-mkimage-socfpga-dist-native)
#NOTE: consider defining a PREFERRED_PROVIDER entry to match u-boot-mkimage-native
# looks like this is the only thing which works: u-boot-mkimage-native
PREFERRED_PROVIDER_u-boot-mkimage-native = "u-boot-mkimage-native"
# with EXTRA_IMAGEDEPENDS it's not being deployed on the rootfs and I think we might have a dependencies problem
#EXTRA_IMAGEDEPENDS += "virtual/bootloader virtual/kernel"
# for some strange reason I don't have any /etc/inittab in the core-image-sato-sdk image, there is in core-image-minimal
# let's enforce it plus some others as well - this is most likely not the best solution ;)
IMAGE_INSTALL += "sysvinit sysvinit-inittab busybox"
# ERROR: QA Issue: File '/etc/init.d/gatord' from gator was already stripped, this will prevent future debugging!
# .workaround - just disabled QA checks until someone really fixes it
INSANE_SKIP_gator_forcevariable = " ldflags already-stripped"
# without linaro tools this needs to be masked:
# .to be precise:
# .  meta-altera/recipes-core/netbase/netbase_5.0.bbappend
BBMASK = ".*/meta-altera/recipes-core"
# for daisy we also need to mask out this recipe:
# .  meta-altera/recipes-images/angstrom/extended-console-image.bb
BBMASK .= "|.*extended-console-image"
# <-- added 
```

## socrates-ml/conf/machine/socfpga_cyclone5.conf
```bitbake
# copied from meta-altera
#@TYPE: Machine
#@NAME: SOCFPGA 
#@DESCRIPTION: Machine configuration for the Cyclone V SoC" 

# --> from meta-altera
require conf/machine/include/socfpga.inc

UBOOT_MACHINE = "socfpga_cyclone5"
# <-- from meta-altera

# --> added
# I want to build also kernel and u-boot automatically:
PREFERRED_PROVIDER_virtual/kernel = "linux-altera-ltsi"
PREFERRED_PROVIDER_virtual/bootloader = "u-boot-socfpga"
#NOTE: multiple providers are available for u-boot-mkimage-native (u-boot-mkimage-native, u-boot-mkimage-socfpga-native, u-boot-mkimage-socfpga-local-native, u-boot-mkimage-socfpga-dist-native)
#NOTE: consider defining a PREFERRED_PROVIDER entry to match u-boot-mkimage-native
# looks like this is the only thing which works: u-boot-mkimage-native
PREFERRED_PROVIDER_u-boot-mkimage-native = "u-boot-mkimage-native"
# with EXTRA_IMAGEDEPENDS it's not being deployed on the rootfs and I think we might have a dependencies problem
#EXTRA_IMAGEDEPENDS += "virtual/bootloader virtual/kernel"
# without linaro tools this needs to be masked:
# .to be precise:
# .  meta-altera/recipes-core/netbase/netbase_5.0.bbappend
BBMASK = ".*/meta-altera/recipes-core"
# for daisy we also need to mask out this recipe:
# .  meta-altera/recipes-images/angstrom/extended-console-image.bb
BBMASK .= "|.*extended-console-image"
# <-- added 
```

## socrates-ml/conf/machine/socrates-ml.conf
```bitbake
#@TYPE: Machine
#@NAME: socrates-ml

#@DESCRIPTION: Machine configuration for socrates-ml systems

EXTRA_IMAGEDEPENDS += "virtual/u-boot"

# I don't want to use the Linaro toolchain
# .for some reasons I need to exclude meta-altera/recipes-core/netbase
BBMASK = "/meta-altera/recipes-core/netbase"
```

## terasic-ml/conf/layer.conf
```bitbake
# We have a conf and classes directory, add to BBPATH
BBPATH .= ":${LAYERDIR}"

# We have a recipes-* directories, add to BBFILES
BBFILES += "${LAYERDIR}/recipes-*/*/*.bb \
	${LAYERDIR}/recipes-*/*/*.bbappend"

BBFILE_COLLECTIONS += "terasic-ml"
BBFILE_PATTERN_terasic-ml = "^${LAYERDIR}/"
BBFILE_PRIORITY_terasic-ml = "6"
```
