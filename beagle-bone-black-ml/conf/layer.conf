## beagle-bone-black-ml/conf/layer.conf
```bitbake
# We have a conf and classes directory, add to BBPATH
BBPATH .= ":${LAYERDIR}"

# We have a recipes-* directories, add to BBFILES
BBFILES += "${LAYERDIR}/recipes-*/*/*.bb \
	${LAYERDIR}/recipes-*/*/*.bbappend"

BBFILE_COLLECTIONS += "beagle-bone-black-ml"
BBFILE_PATTERN_beagle-bone-black-ml = "^${LAYERDIR}/"
BBFILE_PRIORITY_beagle-bone-black-ml = "6"
```

## beagle-bone-black-ml/conf/machine/beagle-bone-black-ml.conf
```bitbake
#@TYPE: Machine
#@NAME: beagle-bone-black-ml

#@DESCRIPTION: Machine configuration for beagle-bone-black-ml systems

PREFERRED_PROVIDER_virtual/xserver ?= "xserver-xorg"
XSERVER ?= "xserver-xorg \
           xf86-input-evdev \
           xf86-input-mouse \
           xf86-video-omapfb \
           xf86-input-keyboard"


# Ship all kernel modules by default
MACHINE_EXTRA_RRECOMMENDS = " kernel-modules"

# Allow for MMC booting (required by the NAND-less Beagleboard XM)
# @@@ hack to get it to compile
#EXTRA_IMAGEDEPENDS += "u-boot x-load"
EXTRA_IMAGEDEPENDS += "u-boot"

# u-boot version
PREFERRED_VERSION_u-boot ?= "v2016.01%"

# kernel version
PREFERRED_VERSION_linux-yocto-custom = "4.4.4%"

# Uncomment the following line to enable the hard floating point abi. Note that
# this breaks some binary libraries and 3D (neither of which ship with
# meta-yocto). For maximum compatibility, leave this disabled.
#DEFAULTTUNE ?= "cortexa8hf-neon"
#include conf/machine/include/tune-cortexa8.inc

# --> try this for a generic armv7a image
DEFAULTTUNE = "armv7a-neon"
require conf/machine/include/arm/arch-armv7a.inc
# <-- try this for a generic armv7a image

IMAGE_FSTYPES += "tar.bz2"
EXTRA_IMAGECMD_jffs2 = "-lnp "

# 2.6.37 and later kernels use OMAP_SERIAL, ttyO0
# earlier kernels use ttyS0
#SERIAL_CONSOLE = "115200 ttyO0"
SERIAL_CONSOLES="console;115200"

PREFERRED_PROVIDER_virtual/kernel ?= "linux-yocto-custom"

KERNEL_IMAGETYPE = "uImage"

UBOOT_MACHINE = "am335x_evm_defconfig"

# in case we don't want LOAD_ADDR hardcoded:
# - need CONFIG_AUTO_ZRELADDR=y
# - need to compile kernel with UIMAGE_TYPE=kernel_noload
# - need in u-boot to load it at 0x80000000 + 0x8000 - 0x40 (U-boot header)
# - here it happens to work also with KERNEL_ADDR_R="0x80300000"

# replaced :
# -->
# hardcoded LOADADDR
#UBOOT_ENTRYPOINT = "0x80008000"
#UBOOT_LOADADDRESS = "0x80008000"
#KERNEL_EXTRA_ARGS += "LOADADDR=${UBOOT_ENTRYPOINT}"
# <--

# with:
# -->
# not hardcoded LOADADDR
UBOOT_ENTRYPOINT = "0x0"
UBOOT_LOADADDRESS = "0x0"
KERNEL_EXTRA_ARGS += "LOADADDR=${UBOOT_ENTRYPOINT} UIMAGE_TYPE=kernel_noload"
# <--

KERNEL_DEVICETREE += "am335x-boneblack.dtb"

MACHINE_FEATURES = "apm usbgadget usbhost vfat alsa"
```

## beagle-bone-black-multi-v7-ml/conf/layer.conf
```bitbake
# We have a conf and classes directory, add to BBPATH
BBPATH .= ":${LAYERDIR}"

# We have a recipes-* directories, add to BBFILES
BBFILES += "${LAYERDIR}/recipes-*/*/*.bb \
	${LAYERDIR}/recipes-*/*/*.bbappend"

BBFILE_COLLECTIONS += "beagle-bone-black-multi-v7-ml"
BBFILE_PATTERN_beagle-bone-black-multi-v7-ml = "^${LAYERDIR}/"
BBFILE_PRIORITY_beagle-bone-black-multi-v7-ml = "7"
```

## beagle-bone-black-multi-v7-ml/conf/machine/beagle-bone-black-multi-v7-ml.conf
```bitbake
#@TYPE: Machine
#@NAME: beagle-bone-black-multi-v7-ml

#@DESCRIPTION: Machine configuration for beagle-bone-black-multi-v7-ml systems
#@ at the moment we build here only u-boot, the rest is built in multi-v7-ml

# --> u-boot stuff

# u-boot not needed for rootfs, but build it anyhow
EXTRA_IMAGEDEPENDS += "u-boot"

# u-boot version
PREFERRED_VERSION_u-boot ?= "v2016.01%"

# for now just one board supported
UBOOT_MACHINE = "am335x_boneblack_config"
# <-- u-boot stuff

# --> compiler tuning stuff 
# try this for generic armv7a image
DEFAULTTUNE = "armv7a-neon"
include conf/machine/include/arm/arch-armv7a.inc
# <-- compiler tuning stuff
```

## beagle-bone-white-ml/conf/layer.conf
```bitbake
# We have a conf and classes directory, add to BBPATH
BBPATH .= ":${LAYERDIR}"

# We have a recipes-* directories, add to BBFILES
BBFILES += "${LAYERDIR}/recipes-*/*/*.bb \
	${LAYERDIR}/recipes-*/*/*.bbappend"

BBFILE_COLLECTIONS += "beagle-bone-white-ml"
BBFILE_PATTERN_beagle-bone-white-ml = "^${LAYERDIR}/"
BBFILE_PRIORITY_beagle-bone-white-ml = "6"
```

## beagle-bone-white-ml/conf/machine/beagle-bone-white-ml.conf
```bitbake
#@TYPE: Machine
#@NAME: beagle-bone-white-ml

#@DESCRIPTION: Machine configuration for beagle-bone-white-ml systems

PREFERRED_PROVIDER_virtual/xserver ?= "xserver-xorg"
XSERVER ?= "xserver-xorg \
           xf86-input-evdev \
           xf86-input-mouse \
           xf86-video-omapfb \
           xf86-input-keyboard"


# Ship all kernel modules by default
MACHINE_EXTRA_RRECOMMENDS = " kernel-modules"

# Allow for MMC booting (required by the NAND-less Beagleboard XM)
# @@@ hack to get it to compile
#EXTRA_IMAGEDEPENDS += "u-boot x-load"
EXTRA_IMAGEDEPENDS += "u-boot"

PREFERRED_VERSION_u-boot ?= "v2013.10%"

# Uncomment the following line to enable the hard floating point abi. Note that
# this breaks some binary libraries and 3D (neither of which ship with
# meta-yocto). For maximum compatibility, leave this disabled.
#DEFAULTTUNE ?= "cortexa8hf-neon"
include conf/machine/include/tune-cortexa8.inc

IMAGE_FSTYPES += "tar.bz2 jffs2"
EXTRA_IMAGECMD_jffs2 = "-lnp "

# 2.6.37 and later kernels use OMAP_SERIAL, ttyO0
# earlier kernels use ttyS0
SERIAL_CONSOLE = "115200 ttyO0"

PREFERRED_PROVIDER_virtual/kernel ?= "linux-yocto-custom"

KERNEL_IMAGETYPE = "uImage"

UBOOT_MACHINE = "am335x_evm_config"
UBOOT_ENTRYPOINT = "0x80008000"
UBOOT_LOADADDRESS = "0x80008000"

KERNEL_EXTRA_ARGS += "LOADADDR=${UBOOT_ENTRYPOINT}"
KERNEL_DEVICETREE += "${S}/arch/arm/boot/dts/am335x-bone.dts"

MACHINE_FEATURES = "apm usbgadget usbhost vfat alsa"
```

## beagle-xm-ml/conf/layer.conf
```bitbake
# We have a conf and classes directory, add to BBPATH
BBPATH .= ":${LAYERDIR}"

# We have a recipes-* directories, add to BBFILES
BBFILES += "${LAYERDIR}/recipes-*/*/*.bb \
	${LAYERDIR}/recipes-*/*/*.bbappend"

BBFILE_COLLECTIONS += "beagle-xm-ml"
BBFILE_PATTERN_beagle-xm-ml = "^${LAYERDIR}/"
BBFILE_PRIORITY_beagle-xm-ml = "6"
```

## beagle-xm-ml/conf/machine/beagle-xm-ml.conf
```bitbake
#@TYPE: Machine
#@NAME: beagle-xm-ml

#@DESCRIPTION: Machine configuration for beagle-xm-ml systems

PREFERRED_PROVIDER_virtual/xserver ?= "xserver-xorg"
XSERVER ?= "xserver-xorg \
           xf86-input-evdev \
           xf86-input-mouse \
           xf86-video-omapfb \
           xf86-input-keyboard"


# Ship all kernel modules by default
MACHINE_EXTRA_RRECOMMENDS = " kernel-modules"

# Allow for MMC booting (required by the NAND-less Beagleboard XM)
# @@@ hack to get it to compile
#EXTRA_IMAGEDEPENDS += "u-boot x-load"
EXTRA_IMAGEDEPENDS += "u-boot"

# u-boot version
PREFERRED_VERSION_u-boot ?= "v2014.01%"

# kernel version
PREFERRED_VERSION_linux-yocto-custom = "3.14.0%"

# Uncomment the following line to enable the hard floating point abi. Note that
# this breaks some binary libraries and 3D (neither of which ship with
# meta-yocto). For maximum compatibility, leave this disabled.
#DEFAULTTUNE ?= "cortexa8hf-neon"
include conf/machine/include/tune-cortexa8.inc

IMAGE_FSTYPES += "tar.bz2 jffs2"
EXTRA_IMAGECMD_jffs2 = "-lnp "

# 2.6.37 and later kernels use OMAP_SERIAL, ttyO2
# earlier kernels use ttyS2
SERIAL_CONSOLE = "115200 ttyO2"

PREFERRED_PROVIDER_virtual/kernel ?= "linux-yocto-custom"

KERNEL_IMAGETYPE = "uImage"

UBOOT_MACHINE = "omap3_beagle_config"
UBOOT_ENTRYPOINT = "0x80008000"
UBOOT_LOADADDRESS = "0x80008000"

KERNEL_EXTRA_ARGS += "LOADADDR=${UBOOT_ENTRYPOINT}"
#KERNEL_DEVICETREE = "${S}/arch/arm/boot/dts/omap3-beagle-xm.dts"
KERNEL_DEVICETREE = "${S}/arch/arm/boot/dts/omap3-beagle-xm-c.dts "
KERNEL_DEVICETREE += "${S}/arch/arm/boot/dts/omap3-beagle-xm-ab.dts "

MACHINE_FEATURES = "apm usbgadget usbhost vfat alsa"

# perf does not build on a 3.13.x kernel, so we exclude it for now
# BBMASK = "/meta/recipes-kernel/perf"
# we'll patch it to compile:
# https://github.com/openembedded/oe-core/tree/master/meta/recipes-kernel/perf

# lttng-modules breaks on a 3.14.x kernel, so we exclude it for now
# BBMASK .= "|meta/recipes-kernel/lttng"
# it seems to be easier to patch lttng
# https://github.com/openembedded/oe-core/tree/master/meta/recipes-kernel/lttng
# but lttng-modules 2.4.0 blacklists arm with gcc-4.8
# so we use lttng-modules 2.3.3 with the bio-bvec-iter.patch and
# also the good old versions of lttng-tools and lttng-ust
# bitbake -s | grep lttng
# lttng-modules                                       :2.3.3-r0
# lttng-tools                                        :v2.3.1-r0
# lttng-ust                                          2:2.3.1-r0
# this is achieved by masking arm for all 3 recipes v2.4.0
```

## igepv2-ml/conf/layer.conf
```bitbake
# We have a conf and classes directory, add to BBPATH
BBPATH .= ":${LAYERDIR}"

# We have a recipes-* directories, add to BBFILES
BBFILES += "${LAYERDIR}/recipes-*/*/*.bb \
	${LAYERDIR}/recipes-*/*/*.bbappend"

BBFILE_COLLECTIONS += "igepv2-ml"
BBFILE_PATTERN_igepv2-ml = "^${LAYERDIR}/"
BBFILE_PRIORITY_igepv2-ml = "6"
```

## m28evk-ml/conf/layer.conf
```bitbake
# We have a conf and classes directory, add to BBPATH
BBPATH .= ":${LAYERDIR}"

# We have a recipes-* directories, add to BBFILES
BBFILES += "${LAYERDIR}/recipes-*/*/*.bb \
	${LAYERDIR}/recipes-*/*/*.bbappend"

BBFILE_COLLECTIONS += "m28evk-ml"
BBFILE_PATTERN_m28evk-ml = "^${LAYERDIR}/"
BBFILE_PRIORITY_m28evk-ml = "6"
```

## m28evk-ml/conf/machine/m28evk-ml.conf
```bitbake
#@TYPE: Machine
#@NAME: m28evk-ml

#@DESCRIPTION: Machine configuration for m28evk-ml systems

PREFERRED_PROVIDER_virtual/xserver = "xserver-xorg"
XSERVER = "xserver-xorg \
           xf86-input-evdev \
           xf86-input-mouse \
           xf86-video-omap \
           xf86-input-keyboard"

# Ship all kernel modules by default
MACHINE_EXTRA_RRECOMMENDS = " kernel-modules"

# Allow for MMC booting 
EXTRA_IMAGEDEPENDS += "u-boot"

# u-boot version
PREFERRED_VERSION_u-boot ?= "v2014.01%"

# kernel version
PREFERRED_VERSION_linux-yocto-custom = "3.13.2%"

# chip tuning 
include conf/machine/include/tune-arm926ejs.inc

#IMAGE_FSTYPES ?= "tar.bz2 ext3 jffs2"
IMAGE_FSTYPES += "tar.bz2 jffs2 ubi"
EXTRA_IMAGECMD_jffs2 = "-lnp "

# => ubi part filesystem
# UBI: attaching mtd1 to ubi0
# UBI: physical eraseblock size:   131072 bytes (128 KiB)
# UBI: logical eraseblock size:    126976 bytes
# UBI: smallest flash I/O unit:    2048
# UBI: VID header offset:          2048 (aligned 2048)
# UBI: data offset:                4096
# UBI error: ubi_read_volume_table: the layout volume was not found
# UBI error: ubi_init: cannot attach mtd1
# UBI error: ubi_init: UBI error: cannot initialize UBI, error -22
# UBI init error 22
#
#
# UBIFS_DIR="rootfs/"             # directory with root file system content
# UBIFS_ERASEBLOCK_SIZE="126976"  # Default UBI LEB size
# UBIFS_MIN_IO_SIZE="2048"        # Minimum input/output unit size
# UBIFS_MAX_LEB_CNT="1850"        # maximum LEB count for the particular filesystem image. 
#                                 # This value is derived from "Amount of eraseblocks" of the NAND 
#                                 # flash and it is slightly lower then that to allow UBI do badblock 
#                                 # handling correctly.
# UBIFS_IMAGE="ubifs.img"         # generated file system image
#                                 # Note: this name has to match the one in ubinize.cfg

# sudo mkfs.ubifs -r ${UBIFS_DIR} -e ${UBIFS_ERASEBLOCK_SIZE} -m ${UBIFS_MIN_IO_SIZE} -c ${UBIFS_MAX_LEB_CNT} -o ${UBIFS_IMAGE}

# MKUBIFS_ARGS = "-m 2048 -e 124KiB -c 124 -x favor_lzo"
MKUBIFS_ARGS = "-m 2048 -e 126976 -c 1850 -x favor_lzo"

# ROOTFS_MIN_IO_SIZE="2048"       # Minimum input/output unit size
# ROOTFS_ERASEBLOCK_SIZE="128KiB" # Eraseblock size
# ROOTFS_SUBPAGE_SIZE="2048"      # Sub-page size
# ROOTFS_IMAGE="ubi.img-${USER}"  # generate image

# sudo ubinize -o ${ROOTFS_IMAGE} -m ${ROOTFS_MIN_IO_SIZE} -p ${ROOTFS_ERASEBLOCK_SIZE} -s ${ROOTFS_SUBPAGE_SIZE} ${HERE}/ubinize.cfg

# UBINIZE_ARGS = "-m 2048 -p 128KiB -s 2048 -O 2048"
UBINIZE_ARGS = "-m 2048 -p 128KiB -s 2048 -O 2048"

# Serial console settings
SERIAL_CONSOLE = "115200 ttyAMA0"

PREFERRED_PROVIDER_virtual/kernel ?= "linux-yocto-custom"

KERNEL_IMAGETYPE = "uImage"

UBOOT_MACHINE = "m28evk_config"
UBOOT_ENTRYPOINT = "0x40008000"
UBOOT_LOADADDRESS = "0x40008000"
UBOOT_MAKE_TARGET = "u-boot.sb"
UBOOT_SUFFIX = "sb"

KERNEL_EXTRA_ARGS += "LOADADDR=${UBOOT_ENTRYPOINT}"
KERNEL_DEVICETREE = "${S}/arch/arm/boot/dts/imx28-m28evk.dts"

#MACHINE_FEATURES = "apm usbgadget usbhost vfat alsa"
MACHINE_FEATURES = "apm usbgadget usbhost vfat alsa touchscreen"
```
