## u-boot-wic-bsp/conf/machine/beagle-bone-black.conf
```bitbake
#@TYPE: Machine
#@NAME: u-boot-wic

#@DESCRIPTION: Machine configuration for u-boot-wic systems

include common.inc
```

## u-boot-wic-bsp/conf/machine/common.inc
```bitbake
#@TYPE: Machine
#@NAME: u-boot-wic

#@DESCRIPTION: Machine configuration for u-boot-wic systems

# the default MACHINE_EXTRA_RRECOMMENDS
# would not install the kernel modules on the core-image-minimal rootfs
# we could also build a core-image-basic to get them included or:
MACHINE_ESSENTIAL_EXTRA_RDEPENDS += " kernel-modules kernel-devicetree"

EXTRA_IMAGEDEPENDS += "u-boot wic-tools"

IMAGE_INSTALL_append = " u-boot-uenv-helper"

DEFAULTTUNE = "armv7a-neon"
include conf/machine/include/arm/arch-armv7a.inc

IMAGE_FSTYPES += "tar.bz2 wic wic.bmap"
#IMAGE_FSTYPES += "tar.bz2 wic"

# zedboard:  ttyPS0
# sitara:    ttyO0
# i.mx6:     ttymxc1
# i.mx6 wand:ttymxc0
# cyclone-v: ttyS0

SERIAL_CONSOLES = "115200;ttyPS0 115200;ttyO0 115200;ttymxc1 115200;ttymxc0 115200;ttyS0"
SERIAL_CONSOLES_CHECK = "${SERIAL_CONSOLES}"

#PREFERRED_VERSION_u-boot ?= "2018.07%"
#PREFERRED_PROVIDER_u-boot-mkimage-native ?= "u-boot-mkimage-native"

PREFERRED_VERSION_u-boot ?= "2018.11%"
PREFERRED_PROVIDER_u-boot-mkimage-native ?= "u-boot-tools-native"

PREFERRED_PROVIDER_virtual/kernel ?= "linux-yocto-custom"

# kernel version
KERNEL_VERSION_PATCHLEVEL="4.19"
KERNEL_SUBLEVEL="13"
PREFERRED_VERSION_linux-yocto-custom = "${KERNEL_VERSION_PATCHLEVEL}.${KERNEL_SUBLEVEL}%"

# don't use instead of "default" version of linux libc headers this version
# which is an exact fit to the kernel version
# LINUXLIBCVERSION ?= "${KERNEL_VERSION_PATCHLEVEL}"

WKS_FILE_am335x-phytec-wega = "am335x-phytec-wega-sd-card.wks"
WKS_FILE_imx6q-phytec-mira-rdk-nand = "imx6q-phytec-mira-rdk-nand-sd-card.wks"
WKS_FILE_beagle-bone-black = "beagle-bone-black.wks"
do_image_wic[depends] += "mtools-native:do_populate_sysroot dosfstools-native:do_populate_sysroot"

KERNEL_IMAGETYPE = "uImage"
KERNEL_DEVICETREE_am335x-phytec-wega = "am335x-wega-rdk.dtb"
KERNEL_DEVICETREE_imx6q-phytec-mira-rdk-nand = "imx6q-phytec-mira-rdk-nand.dtb"
KERNEL_DEVICETREE_beagle-bone-black = "am335x-boneblack.dtb"
KERNEL_EXTRA_ARGS += "LOADADDR=${UBOOT_ENTRYPOINT} UIMAGE_TYPE=kernel_noload "

SPL_BINARYNAME_am335x-phytec-wega = "MLO"
SPL_BINARYNAME_imx6q-phytec-mira-rdk-nand = "SPL"
SPL_BINARYNAME_beagle-bone-black = "MLO"
SPL_BINARY = "${SPL_BINARYNAME}"
UBOOT_SUFFIX = "img"
UBOOT_MACHINE_am335x-phytec-wega = "pcm051_rev3_defconfig"
UBOOT_MACHINE_imx6q-phytec-mira-rdk-nand = "pcm058_defconfig"
UBOOT_MACHINE_beagle-bone-black = "am335x_evm_defconfig"
UBOOT_ENTRYPOINT = "0x0"
UBOOT_LOADADDRESS = "0x0"

MACHINE_FEATURES = "usbgadget usbhost vfat alsa"

IMAGE_BOOT_FILES ?= "u-boot.${UBOOT_SUFFIX} ${SPL_BINARYNAME}"
```

## u-boot-wic-bsp/wic/am335x-phytec-wega-sd-card.wks
```
# short-description: Create SD card image with a boot partition
# long-description:
# Create an image that can be written onto a SD card using dd for use
# with am335x-phytec-wega.
# It uses SPL and u-boot
#
# The disk layout used is:
#  ----- --------- --------------
# | MLO | u-boot  |    rootfs    |
#  ----- --------- --------------
# ^     ^         ^              ^
# |     |         |              |
# 128K  384K      4MiB + rootfs + IMAGE_EXTRA_SPACE (default 10MiB)
#
part SPL --source rawcopy --sourceparams="file=MLO" --ondisk mmcblk --no-table --align 128
part u-boot --source rawcopy --sourceparams="file=u-boot.img" --ondisk mmcblk --no-table --align 384
part / --source rootfs --ondisk mmcblk --fstype=ext4 --label root --align 4096

# -->
# bitbake wic-tools
# wic create ../u-boot-wic-bsp/wic/am335x-phytec-wega-sd-card.wks -e core-image-minimal
# wic create ../am335x-phytec-wega-bsp/wic/am335x-phytec-wega-sd-card.wks -e core-image-minimal
# INFO: Creating image(s)...
#
# WARNING: bootloader config not specified, using defaults
#
# INFO: The new image(s) can be found here:
#  ./am335x-phytec-wega-sd-card-201706031949-mmcblk.direct
#
#The following build artifacts were used to create the image(s):
#  ROOTFS_DIR:                   /tmp/yocto-autobuilder/yocto-autobuilder/yocto-worker/poky-custom-pyro-multi-v7-core-image-minimal/build/tmp/work/am335x_phytec_wega_bsp-poky-linux-gnueabi/core-image-minimal/1.0-r0/rootfs
#  BOOTIMG_DIR:                  /tmp/yocto-autobuilder/yocto-autobuilder/yocto-worker/poky-custom-pyro-multi-v7-core-image-minimal/build/tmp/work/am335x_phytec_wega_bsp-poky-linux-gnueabi/core-image-minimal/1.0-r0/recipe-sysroot/usr/share
#  KERNEL_DIR:                   /tmp/yocto-autobuilder/yocto-autobuilder/yocto-worker/poky-custom-pyro-multi-v7-core-image-minimal/build/tmp/deploy/images/am335x-phytec-wega-bsp
#  NATIVE_SYSROOT:               /tmp/yocto-autobuilder/yocto-autobuilder/yocto-worker/poky-custom-pyro-multi-v7-core-image-minimal/build/tmp/work/am335x_phytec_wega_bsp-poky-linux-gnueabi/core-image-minimal/1.0-r0/recipe-sysroot-native
#
#INFO: The image(s) were created using OE kickstart file:
#  ../am335x-phytec-wega-bsp/wic/am335x-phytec-wega-sd-card.wks
#
# <--

# Notes: (hacked together manually for now and made it work)
# Those things need to be integrated into Yocto:
# 1) we need a patched version of u-boot which also searches for uEnv.txt on ext4 or so partition and not only fat
# 2) we need to add uEnv.txt to / of the rootfs [OK]
# 3) the generated file to be flashed with etcher needs to be ending with .raw or so
# 4) create a bitbake wks target automativally
```

## u-boot-wic-bsp/wic/beagle-bone-black.wks
```
# short-description: Create SD card image with a boot partition
# long-description:
# Create an image that can be written onto an SD card using dd for use
# with beagle-bone-black.
# It uses MLO and u-boot.img
# uEnv.txt is in the rootfs /uEnv.txt
#
# The disk layout used is:
#  ----- --------- --------------
# | MLO | u-boot  |    rootfs    |
#  ----- --------- --------------
# ^     ^         ^              ^
# |     |         |              |
# 128K  384K      4M + rootfs + IMAGE_EXTRA_SPACE
#
part SPL --source rawcopy --sourceparams="file=MLO" --ondisk mmcblk --no-table --align 128
part u-boot --source rawcopy --sourceparams="file=u-boot.img" --ondisk mmcblk --no-table --align 384
part / --source rootfs --ondisk mmcblk --fstype=ext4 --label root --align 4096

# -->
###############################
#
# Y-AB:
# 
# source oe-init-build-env
#
# vim conf/auto.conf
#   MACHINE = "beagle-bone-black"
#
# wic create ../meta-mainline/u-boot-wic-bsp/wic/beagle-bone-black.wks -e core-image-minimal
#
##############################
# bitbake wic-tools
# wic create ../u-boot-wic-bsp/wic/am335x-phytec-wega-sd-card.wks -e core-image-minimal
# wic create ../am335x-phytec-wega-bsp/wic/am335x-phytec-wega-sd-card.wks -e core-image-minimal
# wic create ../meta-mainline/u-boot-wic-bsp/wic/am335x-phytec-wega-sd-card.wks -e core-image-minimal
# INFO: Creating image(s)...
#
# WARNING: bootloader config not specified, using defaults
#
# INFO: The new image(s) can be found here:
#  ./am335x-phytec-wega-sd-card-201706031949-mmcblk.direct
#
#The following build artifacts were used to create the image(s):
#  ROOTFS_DIR:                   /tmp/yocto-autobuilder/yocto-autobuilder/yocto-worker/poky-custom-pyro-multi-v7-core-image-minimal/build/tmp/work/am335x_phytec_wega_bsp-poky-linux-gnueabi/core-image-minimal/1.0-r0/rootfs
#  BOOTIMG_DIR:                  /tmp/yocto-autobuilder/yocto-autobuilder/yocto-worker/poky-custom-pyro-multi-v7-core-image-minimal/build/tmp/work/am335x_phytec_wega_bsp-poky-linux-gnueabi/core-image-minimal/1.0-r0/recipe-sysroot/usr/share
#  KERNEL_DIR:                   /tmp/yocto-autobuilder/yocto-autobuilder/yocto-worker/poky-custom-pyro-multi-v7-core-image-minimal/build/tmp/deploy/images/am335x-phytec-wega-bsp
#  NATIVE_SYSROOT:               /tmp/yocto-autobuilder/yocto-autobuilder/yocto-worker/poky-custom-pyro-multi-v7-core-image-minimal/build/tmp/work/am335x_phytec_wega_bsp-poky-linux-gnueabi/core-image-minimal/1.0-r0/recipe-sysroot-native
#
#INFO: The image(s) were created using OE kickstart file:
#  ../am335x-phytec-wega-bsp/wic/am335x-phytec-wega-sd-card.wks
```

## u-boot-wic-bsp/wic/imx6q-phytec-mira-rdk-nand-sd-card.wks
```
# short-description: Create SD card image with a boot partition
# long-description:
# Create an image that can be written onto a SD card using dd for use
# with am335x-phytec-wega.
# It uses SPL and u-boot
#
# The disk layout used is:
#  ----- --------- --------------
# | MLO | u-boot  |    rootfs    |
#  ----- --------- --------------
# ^     ^         ^              ^
# |     |         |              |
# 128K  384K      4MiB + rootfs + IMAGE_EXTRA_SPACE (default 10MiB)
#
part SPL --source rawcopy --sourceparams="file=SPL" --ondisk mmcblk --no-table --align 1
# u-boot.img and uEnv.txt go on SD card ext4 partition
# u-boot.img part u-boot --source rawcopy --sourceparams="file=u-boot.img" --ondisk mmcblk --no-table --align 384
part / --source rootfs --ondisk mmcblk --fstype=ext4 --label root --align 384

# -->
###############################
#
# Y-AB:
# 
# source oe-init-build-env
#
# vim conf/auto.conf
#   MACHINE = "imx6q-phytec-mira-rdk-nand"
#
# wic create ../meta-mainline/u-boot-wic-bsp/wic/imx6q-phytec-mira-rdk-nand-sd-card.wks -e core-image-minimal
#
##############################
#
# wic create ../u-boot-wic-bsp/wic/imx6q-phytec-mira-rdk-nand-sd-card.wks -e core-image-minimal
#
# INFO: Creating image(s)...
#
# WARNING: bootloader config not specified, using defaults
# 
# INFO: The new image(s) can be found here:
#  ./imx6q-phytec-mira-rdk-nand-sd-card-201706151649-mmcblk.direct
#
# The following build artifacts were used to create the image(s):
#  ROOTFS_DIR:                   /tmp/yocto-autobuilder/yocto-autobuilder/yocto-worker/poky-custom-pyro-multi-v7-core-image-minimal-u-boot-wic/build/tmp/work/imx6q_phytec_mira_rdk_nand-poky-linux-gnueabi/core-image-minimal/1.0-r0/rootfs
#  BOOTIMG_DIR:                  /tmp/yocto-autobuilder/yocto-autobuilder/yocto-worker/poky-custom-pyro-multi-v7-core-image-minimal-u-boot-wic/build/tmp/work/imx6q_phytec_mira_rdk_nand-poky-linux-gnueabi/core-image-minimal/1.0-r0/recipe-sysroot/usr/share
#  KERNEL_DIR:                   /tmp/yocto-autobuilder/yocto-autobuilder/yocto-worker/poky-custom-pyro-multi-v7-core-image-minimal-u-boot-wic/build/tmp/deploy/images/imx6q-phytec-mira-rdk-nand
#  NATIVE_SYSROOT:               /tmp/yocto-autobuilder/yocto-autobuilder/yocto-worker/poky-custom-pyro-multi-v7-core-image-minimal-u-boot-wic/build/tmp/work/imx6q_phytec_mira_rdk_nand-poky-linux-gnueabi/core-image-minimal/1.0-r0/recipe-sysroot-native
#
#INFO: The image(s) were created using OE kickstart file:
#  ../u-boot-wic-bsp/wic/imx6q-phytec-mira-rdk-nand-sd-card.wks
# <--

# Notes: (hacked together manually for now and made it work)
# Those things need to be integrated into Yocto:
# 1) we need a patched version of u-boot which also searches for uEnv.txt on ext4 or so partition and not only fat
# 2) we need to add uEnv.txt to / of the rootfs [OK]
# 3) the generated file to be flashed with etcher needs to be ending with .raw or so
# 4) create a bitbake wks target automativally
```

## vexpress-a9-ml/conf/layer.conf
```bitbake
# We have a conf and classes directory, add to BBPATH
BBPATH .= ":${LAYERDIR}"

# We have a recipes-* directories, add to BBFILES
BBFILES += "${LAYERDIR}/recipes-*/*/*.bb \
	${LAYERDIR}/recipes-*/*/*.bbappend"

BBFILE_COLLECTIONS += "vexpress-a9-ml"
BBFILE_PATTERN_vexpress-a9-ml = "^${LAYERDIR}/"
BBFILE_PRIORITY_vexpress-a9-ml = "6"
```

## vexpressa9/conf/layer.conf
```bitbake
# We have a conf and classes directory, add to BBPATH
BBPATH .= ":${LAYERDIR}"

# We have a recipes-* directories, add to BBFILES
BBFILES += "${LAYERDIR}/recipes-*/*/*.bb \
	${LAYERDIR}/recipes-*/*/*.bbappend"

BBFILE_COLLECTIONS += "vexpressa9"
BBFILE_PATTERN_vexpressa9 = "^${LAYERDIR}/"
BBFILE_PRIORITY_vexpressa9 = "6"
```

## vexpressa9/conf/machine/vexpressa9.conf
```bitbake
#@TYPE: Machine
#@NAME: vexpressa9 machine
#@DESCRIPTION: Machine configuration for the vexpressa9 board 
require conf/machine/include/qemu.inc

PREFERRED_PROVIDER_virtual/xserver = "xserver-xorg"

# Ship all kernel modules by default
MACHINE_EXTRA_RRECOMMENDS = " kernel-modules"

# Allow for MMC booting (required by the NAND-less)
EXTRA_IMAGEDEPENDS += ""

# Uncomment the following line to enable the hard floating point abi. Note that
# this breaks some binary libraries and 3D (neither of which ship with
# meta-yocto). For maximum compatibility, leave this disabled.
#DEFAULTTUNE ?= "cortexa8hf-neon"
#include conf/machine/include/tune-cortexa9.inc

# --> try this for a generic armv7a image
DEFAULTTUNE = "armv7a-neon"
include conf/machine/include/arm/arch-armv7a.inc
# or require?
# <-- try this for a generic armv7a image

IMAGE_CLASSES += "sdcard_image"

IMAGE_FSTYPES += "tar.bz2 ext3 vexpressa9-sdimg"
EXTRA_IMAGECMD_jffs2 = "-lnp "

# 2.6.37 and later kernels use OMAP_SERIAL, ttyO2
# earlier kernels use ttyS2
#SERIAL_CONSOLE = "115200 ttyO2"
# for qemu:
SERIAL_CONSOLE = "38400 ttyAMA0"

PREFERRED_PROVIDER_virtual/kernel ?= "linux-yocto"

# we need this for qemu
EXTRA_IMAGEDEPENDS += "qemu-helper-native meta-ide-support"

KERNEL_IMAGETYPE = "zImage"

#UBOOT_MACHINE = "ca9x4_ct_vxp_config"
# recent mainline u-boot needs this:
UBOOT_MACHINE = "vexpress_ca9x4_config"
UBOOT_ENTRYPOINT = "0x80008000"
UBOOT_LOADADDRESS = "0x80008000"
KERNEL_EXTRA_ARGS += "LOADADDR=${UBOOT_ENTRYPOINT}"

MACHINE_FEATURES = "kernel26 apm usbgadget usbhost vfat alsa"
```

## wandboard-dl-ml/conf/layer.conf
```bitbake
# We have a conf and classes directory, add to BBPATH
BBPATH .= ":${LAYERDIR}"

# We have a recipes-* directories, add to BBFILES
BBFILES += "${LAYERDIR}/recipes-*/*/*.bb \
	${LAYERDIR}/recipes-*/*/*.bbappend"

BBFILE_COLLECTIONS += "wandboard-dl-ml"
BBFILE_PATTERN_wandboard-dl-ml = "^${LAYERDIR}/"
BBFILE_PRIORITY_wandboard-dl-ml = "6"
```
