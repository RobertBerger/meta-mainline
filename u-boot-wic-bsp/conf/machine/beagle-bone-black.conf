## wandboard-dl-ml/conf/machine/wandboard-dl-ml.conf
```bitbake
#@TYPE: Machine
#@NAME: wandboard-dl-ml

#@DESCRIPTION: Machine configuration for wandboard-dl-ml systems

# this should be OK https://github.com/Freescale/meta-fsl-arm/blob/master/conf/machine/include/fsl-default-providers.inc
PREFERRED_PROVIDER_virtual/xserver ?= "xserver-xorg"

#XSERVER_DRIVER_mx6 = "xf86-video-imxfb-vivante"

XSERVER ?= "xserver-xorg \
           xf86-input-evdev \
           xf86-input-mouse \
           xf86-video-fbdev \
           xf86-input-keyboard"

# Ship all kernel modules by default
MACHINE_EXTRA_RRECOMMENDS = " kernel-modules"

# fsl adds this as well:
MACHINE_EXTRA_RRECOMMENDS += " broadcom-nvram-config"

# Allow for MMC booting
EXTRA_IMAGEDEPENDS += "u-boot"

# u-boot version
PREFERRED_VERSION_u-boot ?= "v2014.01%"

# kernel version
PREFERRED_VERSION_linux-yocto-custom = "3.13.2%"

# Uncomment the following line to enable the hard floating point abi. Note that
# this breaks some binary libraries and 3D (neither of which ship with
# meta-yocto). For maximum compatibility, leave this disabled.
#DEFAULTTUNE ?= "cortexa9hf-neon"
# as as the DEFAULTTUNE above is not defined armv7a-neon will be used, which
# is defined in: build/meta/conf/machine/include/tune-cortexa9.inc
include conf/machine/include/tune-cortexa9.inc

# -->
#MACHINE_ARCH_FILTER = "virtual/kernel"
#MACHINE_SOCARCH_FILTER_mx5 = "virtual/libgles1 virtual/libgles2 virtual/egl virtual/mesa virtual/libgl"
#MACHINE_SOCARCH_FILTER_mx6 = "virtual/libgles1 virtual/libgles2 virtual/egl virtual/mesa virtual/libgl"

#INHERIT += "fsl-dynamic-packagearch"

# Firmware
#MACHINE_FIRMWARE ?= ""
#MACHINE_FIRMWARE_append_mx6q = " firmware-imx-vpu-imx6q"
#MACHINE_FIRMWARE_append_mx6d = " firmware-imx-vpu-imx6d"
#MACHINE_FIRMWARE_append_mx6dl = " firmware-imx-vpu-imx6d"
#MACHINE_FIRMWARE_append_mx6s = " firmware-imx-vpu-imx6d"
#MACHINE_FIRMWARE_append_mx53 = " firmware-imx-vpu-imx53 firmware-imx-sdma-imx53"
#MACHINE_FIRMWARE_append_mx51 = " firmware-imx-vpu-imx51 firmware-imx-sdma-imx51"

# FIXME: Needs addition of firmware-imx of official BSPs
##MACHINE_FIRMWARE_append_mx35 = " firmware-imx-sdma-imx35"
##MACHINE_FIRMWARE_append_mx31 = " firmware-imx-sdma-imx31"
##MACHINE_FIRMWARE_append_mx27 = " firmware-imx-vpu-imx27"
##MACHINE_FIRMWARE_append_mx25 = " firmware-imx-sdma-imx25"

#MACHINE_EXTRA_RRECOMMENDS += "${MACHINE_FIRMWARE}"

# Extra audio support
# FIXME: Add support for ALL SoC families
#MACHINE_EXTRA_RRECOMMENDS_append_mx6 = " fsl-alsa-plugins"

# Extra udev rules
#MACHINE_EXTRA_RRECOMMENDS += "udev-extraconf"

# Gstreamer plugin
#MACHINE_GSTREAMER_PLUGIN ?= "gst-fsl-plugin"
#MACHINE_GSTREAMER_PLUGIN_mx3 ?= ""
#MACHINE_GSTREAMER_PLUGIN_vf60 ?= ""

# mx6 GPU libraries
#PREFERRED_PROVIDER_virtual/egl_mx6 ?= "gpu-viv-bin-mx6q"
#PREFERRED_PROVIDER_virtual/libgl_mx6 ?= "gpu-viv-bin-mx6q"
#PREFERRED_PROVIDER_virtual/libgles1_mx6 ?= "gpu-viv-bin-mx6q"
#PREFERRED_PROVIDER_virtual/libgles2_mx6 ?= "gpu-viv-bin-mx6q"

# <--

IMAGE_FSTYPES += "tar.bz2 jffs2"
EXTRA_IMAGECMD_jffs2 = "-lnp "

SERIAL_CONSOLE = "115200 ttymxc0"

PREFERRED_PROVIDER_virtual/kernel ?= "linux-yocto-custom"

KERNEL_IMAGETYPE = "uImage"

UBOOT_MACHINE = "wandboard_dl_config"
UBOOT_ENTRYPOINT = "0x10008000"
UBOOT_LOADADDRESS = "0x10008000"
UBOOT_MAKE_TARGET = "u-boot.imx"
UBOOT_SUFFIX = "imx"

KERNEL_EXTRA_ARGS += "LOADADDR=${UBOOT_ENTRYPOINT}"
KERNEL_DEVICETREE = "${S}/arch/arm/boot/dts/imx6dl-wandboard.dtb"

MACHINE_FEATURES = "apm usbgadget usbhost vfat alsa"
# fsl adds this as well:
MACHINE_FEATURES += "bluetooth wifi pci touchscreen"
```

## wandboard-q-ml/conf/layer.conf
```bitbake
# We have a conf and classes directory, add to BBPATH
BBPATH .= ":${LAYERDIR}"

# We have a recipes-* directories, add to BBFILES
BBFILES += "${LAYERDIR}/recipes-*/*/*.bb \
	${LAYERDIR}/recipes-*/*/*.bbappend"

BBFILE_COLLECTIONS += "wandboard-q-ml"
BBFILE_PATTERN_wandboard-q-ml = "^${LAYERDIR}/"
BBFILE_PRIORITY_wandboard-q-ml = "6"
```

## wandboard-q-ml/conf/machine/wandboard-q-ml.conf
```bitbake
#@TYPE: Machine
#@NAME: wandboard-q-ml

#@DESCRIPTION: Machine configuration for wandboard-q-ml systems

PREFERRED_PROVIDER_virtual/xserver ?= "xserver-xorg"
XSERVER ?= "xserver-xorg \
           xf86-input-evdev \
           xf86-input-mouse \
           xf86-video-omapfb \
           xf86-input-keyboard"


# Ship all kernel modules by default
MACHINE_EXTRA_RRECOMMENDS = " kernel-modules"

# fsl adds this as well:
MACHINE_EXTRA_RRECOMMENDS += " broadcom-nvram-config"

# Allow for MMC booting
EXTRA_IMAGEDEPENDS += "u-boot"

# u-boot version
PREFERRED_VERSION_u-boot ?= "v2014.01%"

# kernel version
PREFERRED_VERSION_linux-yocto-custom = "3.13.0%"

# Uncomment the following line to enable the hard floating point abi. Note that
# this breaks some binary libraries and 3D (neither of which ship with
# meta-yocto). For maximum compatibility, leave this disabled.
#DEFAULTTUNE ?= "cortexa9hf-neon"
# as as the DEFAULTTUNE above is not defined armv7a-neon will be used, which
# is defined in: build/meta/conf/machine/include/tune-cortexa9.inc
include conf/machine/include/tune-cortexa9.inc

IMAGE_FSTYPES += "tar.bz2 jffs2"
EXTRA_IMAGECMD_jffs2 = "-lnp "

SERIAL_CONSOLE = "115200 ttymxc0"

PREFERRED_PROVIDER_virtual/kernel ?= "linux-yocto-custom"

KERNEL_IMAGETYPE = "uImage"

UBOOT_MACHINE = "wandboard_quad_config"
UBOOT_ENTRYPOINT = "0x10008000"
UBOOT_LOADADDRESS = "0x10008000"
UBOOT_MAKE_TARGET = "u-boot.imx"
UBOOT_SUFFIX = "imx"

KERNEL_EXTRA_ARGS += "LOADADDR=${UBOOT_ENTRYPOINT}"
KERNEL_DEVICETREE = "${S}/arch/arm/boot/dts/imx6q-wandboard.dtb"

MACHINE_FEATURES = "apm usbgadget usbhost vfat alsa"
# fsl adds this as well:
MACHINE_FEATURES += "bluetooth wifi pci touchscreen"
```

## zedboard-multi-v7-ml/conf/layer.conf
```bitbake
# We have a conf and classes directory, add to BBPATH
BBPATH .= ":${LAYERDIR}"

# We have a recipes-* directories, add to BBFILES
BBFILES += "${LAYERDIR}/recipes-*/*/*.bb \
	${LAYERDIR}/recipes-*/*/*.bbappend"

BBFILE_COLLECTIONS += "zedboard-multi-v7-ml"
BBFILE_PATTERN_zedboard-multi-v7-ml = "^${LAYERDIR}/"
BBFILE_PRIORITY_zedboard-multi-v7-ml = "7"
```
